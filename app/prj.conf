## CMakeLists.txt
```
#-------------------------------------------------------------------------------
# Zephyr Example Application
#
# Copyright (c) 2021 Nordic Semiconductor ASA
# SPDX-License-Identifier: Apache-2.0

cmake_minimum_required(VERSION 3.20.0)

set(BOARD esp32_devkitc_wrover)

find_package(Zephyr)
find_package(Zephyr REQUIRED HINTS $ENV{ZEPHYR_BASE})

project(my-app)
add_subdirectory(src/components)
target_sources(app PRIVATE src/main.c)
```

## prj.conf
```kconfig
# Copyright (c) 2021 Nordic Semiconductor ASA
# SPDX-License-Identifier: Apache-2.0
#
# This file contains selected Kconfig options for the application.

CONFIG_GPIO=y
CONFIG_ESP32_USE_UNSUPPORTED_REVISION=y
```

## boards/esp32_devkitc_wroom_procpu.overlay
```dts
/ {

	aliases{
		tcrt5000 = &tcrt5000;
	};

        tcrt5000: tcrt5000 {
                compatible = "zephyr,tcrt5000";
                input-gpios = <&gpio0 4 GPIO_ACTIVE_LOW>;
        };

};

&gpio0 {
        status = "okay";
};
```

## src/main.c
```c
/*
 * Copyright (c) 2021 Nordic Semiconductor ASA
 * SPDX-License-Identifier: Apache-2.0
 */
#include <zephyr/kernel.h>
#include <zephyr/drivers/gpio.h>
#include <zephyr/logging/log.h>
#include "tcrt5000.h"

int main(void){

	int ret;

	//Configure TCRT5000 sensor pin
	ret = configureTCRT5000();

	if (ret != 0){
		//Handle configuration error
		return ret;
	}

	while(1){
		//Read the TCRT5000 sensor state
		int sensor_value = readTCRT5000();

		if (sensor_value == 0){
			//white surface detected
			printk("WHITE \n");

		} else if {
			//black surface detected
			printk("BLACK\N");
		} else {
			//handle sensor error
			printk("Error reading TCRT5000 sensor \n");
		}

		//Add a delay between reads
		k_msleep(100);
	}

	return 0;
}
```

## include/tcrt5000.h
```c
#ifndef TCRT5000_H
#define TCRT5000_H

#include <
```
