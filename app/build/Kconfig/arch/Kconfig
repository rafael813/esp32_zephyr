## app/build/Kconfig/arch/Kconfig
```kconfig
# Load arch Kconfig descriptions.
osource "/home/miron/zephyrproject/zephyr/arch/x86/Kconfig"
osource "/home/miron/zephyrproject/zephyr/arch/xtensa/Kconfig"
osource "/home/miron/zephyrproject/zephyr/arch/sparc/Kconfig"
osource "/home/miron/zephyrproject/zephyr/arch/riscv/Kconfig"
osource "/home/miron/zephyrproject/zephyr/arch/posix/Kconfig"
osource "/home/miron/zephyrproject/zephyr/arch/nios2/Kconfig"
osource "/home/miron/zephyrproject/zephyr/arch/mips/Kconfig"
osource "/home/miron/zephyrproject/zephyr/arch/arm64/Kconfig"
osource "/home/miron/zephyrproject/zephyr/arch/arm/Kconfig"
osource "/home/miron/zephyrproject/zephyr/arch/arc/Kconfig"
```
